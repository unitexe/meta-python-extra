## conf/layer.conf
```bitbake
BBPATH .= ":${LAYERDIR}"

BBFILES += "${LAYERDIR}/recipes*/*/*.bb ${LAYERDIR}/recipes*/*/*.bbappend"

BBFILE_COLLECTIONS += "meta-python-extra"
BBFILE_PATTERN_meta-python-extra := "^${LAYERDIR}/"
BBFILE_PRIORITY_meta-python-extra = "13"

LAYERDEPENDS_meta-python-extra = "core openembedded-layer meta-python"

LAYERSERIES_COMPAT_meta-python-extra = "scarthgap styhead walnascar"
```
